#include "tcmp441.h"

#include <stdbool.h>
#include <stdint.h>
#include "led.h"
#include "nordic_common.h"
#include "softdevice_handler.h"
#include "nrf_drv_spi.h"
#include "nrf_delay.h"
#include "app_gpiote.h"
#include "app_util_platform.h"
#include "math.h"
#include <string.h>
#include "board.h"

//qrcode + text
#include "font8x8_basic.h"
#include "qrencode.h"

int LED0 = 18;
int LED1 = 19;
int LED2 = 20;

int nTC_EN   = 24; // B3 on Atum Breakout
int nTC_BUSY = 23; // B4 on Atum Breakout
int nTC_CS   = 22; // B5 on Atum Breakout

static nrf_drv_spi_t _spi = NRF_DRV_SPI_INSTANCE(SPI_INSTANCE);

static void spi_init () {
    uint32_t err;

    nrf_drv_spi_config_t spi_config = NRF_DRV_SPI_DEFAULT_CONFIG(SPI_INSTANCE);
    // Datasheet says we can do 3 MHz, but 4 also seems to work.
    spi_config.frequency = NRF_DRV_SPI_FREQ_4M;
    // We do need CS pin
    spi_config.ss_pin = nTC_CS;
    // Datasheet claims we need CPOL=1 CPHA=1.
    // However, I did not get that to work. MODE 2 does seem to work.
    spi_config.mode = NRF_DRV_SPI_MODE_2;

    // We want blocking mode
    err = nrf_drv_spi_init(&_spi, &spi_config, NULL);
    APP_ERROR_CHECK(err);
}

static void wait_for_not_busy () {
    uint8_t found_busy_low = 0;
    led_on(LED2);

    volatile uint32_t count = 0;

    while (1) {
        uint8_t pin = nrf_gpio_pin_read(nTC_BUSY);
        if (found_busy_low && pin) {
            break;
        }
        if (pin == 0) {
            found_busy_low = 1;
        }

        if(count > 1000000)
        {
            break;
        }
        count++;
    }
    led_off(LED2);

    // Then wait a little longer so we don't violate the T_NS time.
    nrf_delay_us(5);
}

uint8_t screen[15000] = {
255,253,255,255,255,255,255,255,251,127,255,255,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0,
255,183,175,91,250,181,106,170,173,182,247,251,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0,
253,253,255,255,111,255,255,255,238,255,127,190,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0,
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130,144,82,9,40,74,128,74,255,255,239,251,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0,
};

//set pixel value at x and y coordinate
void tcmp441_setPixel(int x, int y, int on/*1 or 0*/){
    //index in screen array
    int index = (y * 50) + ((50 * x)/400);
    int bitsIntoByte = 7 - (x % 8);

    //turns the nth bit on or off
    screen[index] ^= (-on ^ screen[index]) & (1 << bitsIntoByte); //jeremy ruten stack overflow
}

//clears the screen by setting all elements to 0
void tcmp441_clearScreen(){
    memset(screen, 0, 15000 * sizeof(uint8_t));
}

//inserts a grid of pixels into the image - NOTE - coordinate is @ uper left
//the grid of pixels is in the form of 0s and 1s, a 0 representing pixel off and 1 representing pixel on
void tcmp441_insertPixelGrid(int width, int height, uint8_t grid[height][width], int xcoord, int ycoord){
    for(int y = 0; y < height; y++){
        for(int x = 0; x < width; x++){
            if(grid[y][x] == 1){
                tcmp441_setPixel(x + xcoord, y + ycoord, 1);//pixel on
            }
            else{
                tcmp441_setPixel(x + xcoord, y + ycoord, 0);//pixel off
            }
        }
    }
}

//writes a single character at (x,y) with a given scale
//a scale of 1 produces an 8x8 pixel character
//each character in font8x8_basic.h is written in 8 lines of 8 hex bytes where each bit of the 8 bytes represents a single pixel
void tcmp441_writeCharacterAtLocation(char character, int xcoord, int ycoord, uint8_t scale){
    //convert the 8 hex bytes from font8x8_basic.h into an 8x8 pixel array
    uint8_t grid[8][8];
    char *bitmap = font8x8_basic[character];//selects array of 8 hex bytes from font8x8_basic.h based on character code

    //loop over each row in the character
    for(int i = 0; i < 8; i++){
        //loop over each bit in the character
        for(int j = 0; j < 8; j++){
            //select the jth bit from the hex byte to add to the 8x8 pixel array
            grid[i][j] = (bitmap[i] & (1 << j)) >> j;
        }
    }

    //scale the character by the scale multiplier
    if(scale != 1){
        //loop over a scaled version of the character
        for(int y = 0; y < 8 * scale; y++){
            for(int x = 0; x < 8 * scale; x++){
                tcmp441_setPixel(xcoord + x, ycoord + y, grid[y/scale][x/scale]);
            }
        }

        return;
    }

    tcmp441_insertPixelGrid(8, 8, grid, xcoord, ycoord);
}

//writes a string of ascii characters at an x,y coordinate with a given scale
void tcmp441_writeStringAtLocation(char *str, int x, int y, int scale){
    //loop over each character in the string
    for(int i = 0; i < strlen(str); i++){
        //if the character won't be written off the edge of the screen
        if(x + (8 * i * scale) + 8*scale < 400){
            //write the character that the location after the previous characters
            tcmp441_writeCharacterAtLocation(str[i], x + (8*i * scale), y, scale);
        }
    }
}

//sets a block of 8x8 pixels on or off. x < 50 & y < 38
void tcmp441_setBlock(int x, int y, int on)
{
    for(int i = 0; i < 8; i++)
    {
        if(on == 1){
            screen[x + (50 * i) + (50 * y * 8)] = 255;
        }else{
            screen[x + (50 * i) + (50 * y * 8)] = 0;
        }
        
    }
}

//inserts a grid of pixels, but much larger
void tcmp441_insertBigPixelGrid(int width, int height, uint8_t grid[height][width], int xcoord, int ycoord)
{
    for(int y = 0; y < height; y++)
    {
        for(int x = 0; x <width; x++)
        {
            if(grid[y][x] == 1)
            {
                setBlock(x, y, 1);
            }
            else
            {
                setBlock(x, y, 0);
            }
        }
    }
}

//write a qr code to the screen. Can handle up to 52 characters
void tcmp441_writeQRcode(char *str)
{
    QRcode *qrcode;
    qrcode = QRcode_encodeString8bit(str, 0, 0);
    uint8_t width = qrcode->width;

    /*
    for(int i = 0; i < 17; i++)
    {
        char stuff[50];

        sprintf(stuff, "%x", (*qrcode).data[i]);
        writeStringAtLocation(stuff, 0, i * 8 * 2, 2);
    }
    */

    uint8_t grid[width][width];

    for(int i = 0; i < width * width; i++)
    {
        int x = i % width;
        int y = i / width;

        grid[x][y] = (*qrcode).data[i] & 1;
    }
    
    insertBigPixelGrid(width, width, grid, 10, 10);

}

//update display
uint8_t tx[6] = {0x30, 0x01, 0x01, 0x00, 0x00, 0x00};
uint8_t rx[256] = {0};
void tcmp441_updateDisplay()
{   
    nrf_gpio_pin_clear(nTC_EN);

    // Need to wait 6.5 ms per datasheet (section 5.5)
    // Up that a little to be safe and who cares about a couple ms
    nrf_delay_ms(10);


    memset(rx, 0, 256 * sizeof(uint8_t));
    tx[0] = 0x30;
    tx[1] = 0x01;
    tx[2] = 0x01;
    tx[3] = 0x00;
    tx[4] = 0x00;
    tx[5] = 0x00;

    uint8_t pic[255];

    // Setup spi comm header
    pic[0] = 0x20;
    pic[1] = 0x01;
    pic[2] = 0x00;

    // How many bytes we want to send.
    pic[3] = 16;

    // Pic header
    pic[4] = 0x33; // 4.41"
    pic[5] = 0x01; // 400px
    pic[6] = 0x90;
    pic[7] = 0x01; // 300px
    pic[8] = 0x2c;
    pic[9] = 0x01; // 1 bit
    // pic[10] = 0x02; // image pixel data format type 2
    pic[10] = 0x00; // image pixel data format type 0
    pic[11] = 0; // reserved
    pic[12] = 0;
    pic[13] = 0;
    pic[14] = 0;
    pic[15] = 0;
    pic[16] = 0;
    pic[17] = 0;
    pic[18] = 0;
    pic[19] = 0;

    // Send header
    nrf_drv_spi_transfer(&_spi, pic, 20, NULL, 0);
    wait_for_not_busy();//THIS LINE FRICKEN MESSES EVERYTHING UP

    nrf_drv_spi_transfer(&_spi, NULL, 0, rx, 2);
    wait_for_not_busy();

    uint8_t i;

    // display an image
    pic[3] = 250;
    for (i=0; i<60; i++) {
        memcpy(pic+4, screen+(i*250), 250); // screen logo
        //memset(pic+4, 0xFF, 250); // Black screen
        //memset(pic+4, 0x00, 250); // White screen

        nrf_drv_spi_transfer(&_spi, pic, 254, NULL, 0);
        wait_for_not_busy();
        nrf_drv_spi_transfer(&_spi, NULL, 0, rx, 2);
        wait_for_not_busy();
    }

    // Actually render the image
    tx[0] = 0x24;
    tx[1] = 0x01;
    tx[2] = 0x00;

    nrf_drv_spi_transfer(&_spi, tx, 3, NULL, 0);
    wait_for_not_busy();
    nrf_drv_spi_transfer(&_spi, NULL, 0, rx, 2);
    wait_for_not_busy();


    nrf_gpio_pin_set(nTC_EN);
}

//set up led and spi
void tcmp441_init(int led0, int led1, int led2, int ntc_en, int ntc_busy, int ntc_cs)
{
	//define
	LED0 = led0;
	LED1 = led1;
	LED2 = led2;

	nTC_EN = ntc_en;
	nTC_BUSY = ntc_busy;
	nTC_CS = ntc_cs;

    tcmp441_clearScreen();

    led_init(LED0);
    led_off(LED0);
    led_init(LED1);
    led_off(LED1);
    led_init(LED2);
    led_off(LED2);

    // Setup input for busy
    nrf_gpio_cfg_input(nTC_BUSY, NRF_GPIO_PIN_NOPULL);

    // Assert ENABLE
    nrf_gpio_cfg_output(nTC_EN);
    

    // Setup SPI
    spi_init();

    //uint8_t tx[6] = {0x30, 0x01, 0x01, 0x00, 0x00, 0x00};
    //uint8_t rx[256] = {0};

    // Get device id to check that we can comm with this display
    // Send the command
    nrf_drv_spi_transfer(&_spi, tx, 4, NULL, 0);

    // Wait until no longer busy
    wait_for_not_busy();

    // Receive response
    nrf_drv_spi_transfer(&_spi, NULL, 0, rx, 28);

    // Not sure, sometimes busy signal, sometimes not?
    // Just wait for a hot sec for now
    nrf_delay_ms(1);
}







